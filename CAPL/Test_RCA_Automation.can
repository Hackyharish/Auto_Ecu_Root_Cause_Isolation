/*@!Encoding:1252*/
/* =========================================================================
   Test Module: Test_RCA_Automation.can
   Project: Automated Root Cause Isolation in Multi-ECU Networks
   Description: Vector CANoe CAPL Test Module (Test Feature Set / TFS).
                Sequentially validates Pre-condition rejection, Scenarios 1 to 6,
                pruning accuracy, execution latency (<50ms), and writes
                both native CANoe test reports and formatted HTML Test Reports.
   Author: IVN Capstone Team | Tata Technologies TechPulse
   ========================================================================= */

includes
{
  #include "Common_UDS.cin"
}

variables
{
  dword g_ReportFile;
  int g_PassCount = 0;
  int g_FailCount = 0;
}

void writeLineFile(dword hFile, char text[])
{
  char buf[2048];
  long len;
  if (hFile == 0) return;
  len = snprintf(buf, elCount(buf), "%s\n", text);
  if (len > 0)
  {
    filePutString(buf, len, hFile);
  }
}

void LogHtmlHeader()
{
  writeLineFile(g_ReportFile, "<!DOCTYPE html>");
  writeLineFile(g_ReportFile, "<html><head><meta charset='utf-8'>");
  writeLineFile(g_ReportFile, "<title>Automated RCA Test Execution Report</title>");
  writeLineFile(g_ReportFile, "<style>");
  writeLineFile(g_ReportFile, "body { font-family: 'Segoe UI', Arial, sans-serif; margin: 20px; background: #f4f6f9; color: #333; }");
  writeLineFile(g_ReportFile, ".container { max-width: 1000px; margin: auto; background: #fff; padding: 25px; border-radius: 8px; box-shadow: 0 4px 12px rgba(0,0,0,0.1); }");
  writeLineFile(g_ReportFile, "h1 { color: #1a365d; border-bottom: 2px solid #2b6cb0; padding-bottom: 10px; }");
  writeLineFile(g_ReportFile, ".summary { display: flex; gap: 20px; margin-bottom: 20px; }");
  writeLineFile(g_ReportFile, ".badge { padding: 10px 20px; border-radius: 6px; font-weight: bold; font-size: 16px; }");
  writeLineFile(g_ReportFile, ".pass { background: #c6f6d5; color: #22543d; border: 1px solid #38a169; }");
  writeLineFile(g_ReportFile, ".fail { background: #fed7d7; color: #742a2a; border: 1px solid #e53e3e; }");
  writeLineFile(g_ReportFile, "table { width: 100%; border-collapse: collapse; margin-top: 15px; }");
  writeLineFile(g_ReportFile, "th, td { border: 1px solid #e2e8f0; padding: 12px; text-align: left; }");
  writeLineFile(g_ReportFile, "th { background: #2b6cb0; color: #fff; }");
  writeLineFile(g_ReportFile, "tr:nth-child(even) { background: #f8fafc; }");
  writeLineFile(g_ReportFile, ".status-pass { color: #2e8540; font-weight: bold; }");
  writeLineFile(g_ReportFile, ".status-fail { color: #d9381e; font-weight: bold; }");
  writeLineFile(g_ReportFile, "</style></head><body>");
  writeLineFile(g_ReportFile, "<div class='container'>");
  writeLineFile(g_ReportFile, "<h1>Automated Multi-ECU Root Cause Isolation: Test Execution Report</h1>");
  writeLineFile(g_ReportFile, "<p><b>Standard:</b> ISO 14229 / ISO 26262 ASIL-D | <b>ECU Target:</b> Central Diagnostic Gateway</p>");
  writeLineFile(g_ReportFile, "<table><thead><tr>");
  writeLineFile(g_ReportFile, "<th>TC #</th><th>Test Scenario Description</th><th>Target ECU</th><th>Expected Root DTC</th><th>Latency</th><th>Verdict</th>");
  writeLineFile(g_ReportFile, "</tr></thead><tbody>");
}

void LogHtmlRow(int tcNum, char desc[], char ecu[], char dtc[], double lat, byte isPass)
{
  char row[512];
  char verdict[64];
  if (isPass == 1)
  {
    snprintf(verdict, elCount(verdict), "<span class='status-pass'>PASSED</span>");
    g_PassCount++;
  }
  else
  {
    snprintf(verdict, elCount(verdict), "<span class='status-fail'>FAILED</span>");
    g_FailCount++;
  }

  snprintf(row, elCount(row), "<tr><td>TC_%02d</td><td>%s</td><td>%s</td><td><b>%s</b></td><td>%.2f ms</td><td>%s</td></tr>",
    tcNum, desc, ecu, dtc, lat, verdict);
  writeLineFile(g_ReportFile, row);
}

void LogHtmlFooter()
{
  char summary[512];
  writeLineFile(g_ReportFile, "</tbody></table><br>");
  writeLineFile(g_ReportFile, "<div class='summary'>");
  snprintf(summary, elCount(summary), "<div class='badge pass'>Total Passed: %d</div><div class='badge fail'>Total Failed: %d</div>", g_PassCount, g_FailCount);
  writeLineFile(g_ReportFile, summary);
  writeLineFile(g_ReportFile, "</div>");
  writeLineFile(g_ReportFile, "<p><i>Generated automatically by CANoe CAPL Automated Test Module.</i></p>");
  writeLineFile(g_ReportFile, "</div></body></html>");
  fileClose(g_ReportFile);
  write("\n===================================================================");
  write(" [TEST SUITE COMPLETED] Total Tests: %d | Passed: %d | Failed: %d", g_PassCount + g_FailCount, g_PassCount, g_FailCount);
  write(" Test Report saved to Logs/RCA_Automated_Test_Report.html");
  write("===================================================================\n");
}

// -----------------------------------------------------------------------------
// TEST CASES (Vector CANoe Test Feature Set)
// -----------------------------------------------------------------------------

testcase TC_01_Precondition_Rejection()
{
  char resDTC[32];

  // Turn Ignition OFF
  @sysvar::Sim_IgnitionState = 0;
  @sysvar::Trigger_RCA_Scan = 1;
  testWaitForTimeout(200);

  sysGetVariableString(sysvar::RCA_Output_RootDTC, resDTC, elCount(resDTC));
  if (strncmp(resDTC, "Pre-conditions", 14) == 0)
  {
    testStepPass("TC1", "Pre-conditions correctly inhibited scan when Ignition is OFF.");
    LogHtmlRow(1, "Pre-condition Rejection: Vehicle Ignition OFF", "N/A (Inhibited)", "Pre-conditions Failed", 0.0, 1);
  }
  else
  {
    testStepFail("TC1", "Diagnostics scan was not properly inhibited when vehicle was OFF.");
    LogHtmlRow(1, "Pre-condition Rejection: Vehicle Ignition OFF", "N/A (Inhibited)", "Pre-conditions Failed", 0.0, 0);
  }

  // Restore Nominal Vehicle State
  @sysvar::Sim_IgnitionState = 2;
  @sysvar::Sim_BatteryVoltage = 13.8;
  @sysvar::Fault_Reset_All = 1;
  testWaitForTimeout(250);
}

testcase TC_02_Scenario1_ABS_WSS()
{
  char resDTC[32];

  // Inject Scenario 1
  @sysvar::Fault_ABS_WheelSpeedFL = 1;
  testWaitForTimeout(200);

  // Trigger RCA Scan
  @sysvar::Trigger_RCA_Scan = 1;
  testWaitForTimeout(250);

  sysGetVariableString(sysvar::RCA_Output_RootDTC, resDTC, elCount(resDTC));
  if (strncmp(resDTC, "C0035-13", 8) == 0 && @sysvar::RCA_Result_Latency < 50.0)
  {
    testStepPass("TC2", "Scenario 1 isolated root DTC C0035-13 in ABS within latency target.");
    LogHtmlRow(2, "Scenario 1: Left Front Wheel Speed Sensor Open", "ABS/ESP", "C0035-13", @sysvar::RCA_Result_Latency, 1);
  }
  else
  {
    testStepFail("TC2", "Scenario 1 failed to isolate C0035-13 within target latency.");
    LogHtmlRow(2, "Scenario 1: Left Front Wheel Speed Sensor Open", "ABS/ESP", "C0035-13", @sysvar::RCA_Result_Latency, 0);
  }

  @sysvar::Fault_Reset_All = 1;
  testWaitForTimeout(250);
}

testcase TC_03_Scenario2_ECM_TPS()
{
  char resDTC[32];

  @sysvar::Fault_ECM_ThrottleSensor = 1;
  testWaitForTimeout(200);

  @sysvar::Trigger_RCA_Scan = 1;
  testWaitForTimeout(250);

  sysGetVariableString(sysvar::RCA_Output_RootDTC, resDTC, elCount(resDTC));
  if (strncmp(resDTC, "P0122-12", 8) == 0 && @sysvar::RCA_Result_Latency < 50.0)
  {
    testStepPass("TC3", "Scenario 2 isolated root DTC P0122-12 in ECM within latency target.");
    LogHtmlRow(3, "Scenario 2: Throttle Position Sensor Low Circuit", "ECM", "P0122-12", @sysvar::RCA_Result_Latency, 1);
  }
  else
  {
    testStepFail("TC3", "Scenario 2 failed to isolate P0122-12 within target latency.");
    LogHtmlRow(3, "Scenario 2: Throttle Position Sensor Low Circuit", "ECM", "P0122-12", @sysvar::RCA_Result_Latency, 0);
  }

  @sysvar::Fault_Reset_All = 1;
  testWaitForTimeout(250);
}

testcase TC_04_Scenario3_ECM_Node_Dropout()
{
  char resDTC[32];

  @sysvar::Fault_Node_Cutoff_ECM = 1;
  testWaitForTimeout(350);

  @sysvar::Trigger_RCA_Scan = 1;
  testWaitForTimeout(250);

  sysGetVariableString(sysvar::RCA_Output_RootDTC, resDTC, elCount(resDTC));
  if (strncmp(resDTC, "U0100-00", 8) == 0)
  {
    testStepPass("TC4", "Scenario 3 isolated ECM node dropout DTC U0100-00.");
    LogHtmlRow(4, "Scenario 3: Complete ECM Node Loss / Bus Dropout", "ECM", "U0100-00", @sysvar::RCA_Result_Latency, 1);
  }
  else
  {
    testStepFail("TC4", "Scenario 3 failed to isolate U0100-00.");
    LogHtmlRow(4, "Scenario 3: Complete ECM Node Loss / Bus Dropout", "ECM", "U0100-00", @sysvar::RCA_Result_Latency, 0);
  }

  @sysvar::Fault_Reset_All = 1;
  testWaitForTimeout(250);
}

testcase TC_05_Scenario4_Coolant_Overheat()
{
  char resDTC[32];

  @sysvar::Fault_ECM_CoolantTemp = 1;
  testWaitForTimeout(200);

  @sysvar::Trigger_RCA_Scan = 1;
  testWaitForTimeout(250);

  sysGetVariableString(sysvar::RCA_Output_RootDTC, resDTC, elCount(resDTC));
  if (strncmp(resDTC, "P0217-00", 8) == 0)
  {
    testStepPass("TC5", "Scenario 4 isolated Coolant Overheat DTC P0217-00.");
    LogHtmlRow(5, "Scenario 4: Engine Coolant Over-Temperature", "ECM", "P0217-00", @sysvar::RCA_Result_Latency, 1);
  }
  else
  {
    testStepFail("TC5", "Scenario 4 failed to isolate P0217-00.");
    LogHtmlRow(5, "Scenario 4: Engine Coolant Over-Temperature", "ECM", "P0217-00", @sysvar::RCA_Result_Latency, 0);
  }

  @sysvar::Fault_Reset_All = 1;
  testWaitForTimeout(250);
}

testcase TC_06_Scenario5_BCM_Brake_Switch()
{
  char resDTC[32];

  @sysvar::Fault_BCM_BrakeSwitch = 1;
  testWaitForTimeout(200);

  @sysvar::Trigger_RCA_Scan = 1;
  testWaitForTimeout(250);

  sysGetVariableString(sysvar::RCA_Output_RootDTC, resDTC, elCount(resDTC));
  if (strncmp(resDTC, "B1318-11", 8) == 0)
  {
    testStepPass("TC6", "Scenario 5 isolated Brake Switch Stuck DTC B1318-11.");
    LogHtmlRow(6, "Scenario 5: Brake Pedal Switch Stuck High", "BCM", "B1318-11", @sysvar::RCA_Result_Latency, 1);
  }
  else
  {
    testStepFail("TC6", "Scenario 5 failed to isolate B1318-11.");
    LogHtmlRow(6, "Scenario 5: Brake Pedal Switch Stuck High", "BCM", "B1318-11", @sysvar::RCA_Result_Latency, 0);
  }

  @sysvar::Fault_Reset_All = 1;
  testWaitForTimeout(250);
}

testcase TC_07_Scenario6_ABS_Node_Dropout()
{
  char resDTC[32];

  @sysvar::Fault_Node_Cutoff_ABS = 1;
  testWaitForTimeout(350);

  @sysvar::Trigger_RCA_Scan = 1;
  testWaitForTimeout(250);

  sysGetVariableString(sysvar::RCA_Output_RootDTC, resDTC, elCount(resDTC));
  if (strncmp(resDTC, "U0121-00", 8) == 0)
  {
    testStepPass("TC7", "Scenario 6 isolated ABS node dropout DTC U0121-00.");
    LogHtmlRow(7, "Scenario 6: Complete ABS Node Dropout / Bus Loss", "ABS/ESP", "U0121-00", @sysvar::RCA_Result_Latency, 1);
  }
  else
  {
    testStepFail("TC7", "Scenario 6 failed to isolate U0121-00.");
    LogHtmlRow(7, "Scenario 6: Complete ABS Node Dropout / Bus Loss", "ABS/ESP", "U0121-00", @sysvar::RCA_Result_Latency, 0);
  }

  @sysvar::Fault_Reset_All = 1;
  testWaitForTimeout(250);
}

// -----------------------------------------------------------------------------
// TEST MODULE ENTRY POINT
// -----------------------------------------------------------------------------
void MainTest()
{
  write("\n===================================================================");
  write(" [TEST MODULE] Starting Automated Multi-ECU RCA Regression Test Suite...");
  write("===================================================================");

  g_ReportFile = openFileWrite("Logs/RCA_Automated_Test_Report.html", 2); // Overwrite mode
  if (g_ReportFile == 0)
  {
    g_ReportFile = openFileWrite("RCA_Automated_Test_Report.html", 2);
  }
  LogHtmlHeader();

  g_PassCount = 0;
  g_FailCount = 0;

  TC_01_Precondition_Rejection();
  TC_02_Scenario1_ABS_WSS();
  TC_03_Scenario2_ECM_TPS();
  TC_04_Scenario3_ECM_Node_Dropout();
  TC_05_Scenario4_Coolant_Overheat();
  TC_06_Scenario5_BCM_Brake_Switch();
  TC_07_Scenario6_ABS_Node_Dropout();

  LogHtmlFooter();
}
