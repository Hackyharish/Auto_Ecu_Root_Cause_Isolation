/*@!Encoding:1252*/
/* =========================================================================
   File: Common_UDS.cin
   Project: Automated Root Cause Isolation in Multi-ECU Networks
   Description: Common UDS (ISO 14229 / ISO 15765-2) constants, definitions,
                and shared helper structures.
   Author: IVN Capstone Team | Tata Technologies TechPulse
   ========================================================================= */

includes
{
}

variables
{
  // Structure to hold DTC entry inside ECU memory
  struct DTCEntry
  {
    dword dtcNumber;    // 3-byte DTC e.g., 0xC0035 or 0x012200
    byte  statusMask;   // ISO 14229 status byte
    dword snapshotSpeed;
    dword snapshotVoltage;
  };

  // UDS Service Identifiers (SIDs)
  const byte UDS_SID_DIAGNOSTIC_SESSION_CONTROL    = 0x10;
  const byte UDS_SID_ECU_RESET                     = 0x11;
  const byte UDS_SID_CLEAR_DIAGNOSTIC_INFORMATION  = 0x14;
  const byte UDS_SID_READ_DTC_INFORMATION          = 0x19;
  const byte UDS_SID_READ_DATA_BY_IDENTIFIER       = 0x22;
  const byte UDS_SID_SECURITY_ACCESS               = 0x27;
  const byte UDS_SID_TESTER_PRESENT                = 0x3E;
  const byte UDS_SID_NEGATIVE_RESPONSE             = 0x7F;

  // Subfunctions
  const byte UDS_SUBF_DEFAULT_SESSION              = 0x01;
  const byte UDS_SUBF_PROGRAMMING_SESSION          = 0x02;
  const byte UDS_SUBF_EXTENDED_SESSION             = 0x03;
  const byte UDS_SUBF_REPORT_NUMBER_OF_DTC_BY_MASK = 0x01;
  const byte UDS_SUBF_REPORT_DTC_BY_STATUS_MASK    = 0x02;
  const byte UDS_SUBF_REPORT_DTC_SNAPSHOT_BY_DTC   = 0x04;

  // Negative Response Codes (NRCs)
  const byte UDS_NRC_GENERAL_REJECT                = 0x10;
  const byte UDS_NRC_SERVICE_NOT_SUPPORTED         = 0x11;
  const byte UDS_NRC_SUBFUNCTION_NOT_SUPPORTED     = 0x12;
  const byte UDS_NRC_INCORRECT_MESSAGE_LENGTH      = 0x13;
  const byte UDS_NRC_CONDITIONS_NOT_CORRECT        = 0x22;
  const byte UDS_NRC_REQUEST_OUT_OF_RANGE          = 0x31;

  // DTC Status Mask Bits (ISO 14229-1)
  const byte DTC_STATUS_TEST_FAILED                = 0x01;
  const byte DTC_STATUS_TEST_FAILED_THIS_CYCLE     = 0x02;
  const byte DTC_STATUS_PENDING_DTC                = 0x04;
  const byte DTC_STATUS_CONFIRMED_DTC              = 0x08;
  const byte DTC_STATUS_TEST_NOT_COMPLETED_SINCE_CLEAR = 0x10;
  const byte DTC_STATUS_TEST_FAILED_SINCE_CLEAR    = 0x20;
  const byte DTC_STATUS_TEST_NOT_COMPLETED_THIS_CYCLE = 0x40;
  const byte DTC_STATUS_WARNING_INDICATOR_REQ      = 0x80;

  // Standard Diagnostic CAN IDs
  const dword CAN_ID_DIAG_FUNCTIONAL_REQ           = 0x7DF;
  const dword CAN_ID_ECM_REQ                       = 0x7E0;
  const dword CAN_ID_ECM_RESP                      = 0x7E8;
  const dword CAN_ID_TCM_REQ                       = 0x7E1;
  const dword CAN_ID_TCM_RESP                      = 0x7E9;
  const dword CAN_ID_ABS_REQ                       = 0x7E2;
  const dword CAN_ID_ABS_RESP                      = 0x7EA;
  const dword CAN_ID_BCM_REQ                       = 0x7E3;
  const dword CAN_ID_BCM_RESP                      = 0x7EB;

  // Maximum stored DTCs per simulated ECU
  const int MAX_DTCS = 8;
}
