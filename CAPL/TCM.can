/*@!Encoding:1252*/
/* =========================================================================
   Node: TCM.can (Transmission Control Module)
   Project: Automated Root Cause Isolation in Multi-ECU Networks
   Description: Simulates Automatic Transmission ECU. Demonstrates cross-ECU
                signal dependency handling (ECM & ABS telemetry), automatic
                gear shifts, secondary symptom DTC qualification, and UDS Server.
   Author: IVN Capstone Team | Tata Technologies TechPulse
   ========================================================================= */

includes
{
  #include "Common_UDS.cin"
}

variables
{
  // Timers
  msTimer t_TCM_20ms;

  // CAN Messages
  message 0x300 msg_TCM;
  message 0x7E9 msg_TCM_DiagResp;

  // Transmission State Variables
  byte   g_CurrentGear = 3; // D1
  byte   g_TargetGear = 3;
  byte   g_ClutchStatus = 1; // ENGAGED
  double g_TransOilTemp = 85.0;
  byte   g_DegradedMode = 0;
  byte   g_AliveCounter = 0;

  // Subscribed External Data (Dependencies)
  double g_RxEngineRPM = 850.0;
  double g_RxThrottlePos = 0.0;
  double g_RxVehicleSpeed = 0.0;
  double g_RxSpeedFL = 0.0;
  double g_RxSpeedFR = 0.0;
  dword  g_LastECMTimestamp = 0;
  dword  g_LastABSTimestamp = 0;

  // Diagnostic State & DTC Memory
  byte g_DiagSession = UDS_SUBF_DEFAULT_SESSION;
  struct DTCEntry g_TCM_DTCs[MAX_DTCS];
  int g_NumDTCs = 0;

  // Secondary Fault Tracking Flags
  byte g_Symptom_U0415_Active = 0;
  byte g_Symptom_U0401_Active = 0;
  byte g_Symptom_U0100_Active = 0;
  byte g_Symptom_Coolant_Active = 0;
  byte g_Symptom_Brake_Active = 0;
  byte g_Symptom_ABS_Lost_Active = 0;
  byte g_Fault_Cutoff_TCM_Active = 0;
}

on start
{
  write("[TCM] Node Started. Monitoring ECM and ABS dependency channels...");
  g_NumDTCs = 0;
  setTimer(t_TCM_20ms, 20);
}

// -----------------------------------------------------------------------------
// 20ms Cyclic Broadcast: TCM_Status (0x300)
// -----------------------------------------------------------------------------
on timer t_TCM_20ms
{
  byte isAsilDSafeStop;
  isAsilDSafeStop = 0;

  g_AliveCounter = (g_AliveCounter + 1) & 0x0F;

  // Latch TCM cutoff trigger pulse
  if (@sysvar::Fault_Node_Cutoff_TCM == 1)
  {
    g_Fault_Cutoff_TCM_Active = 1;
  }

  // Authoritative vehicle speed sync from cluster telemetry
  if (@sysvar::Disp_VehicleSpeed >= 0.0)
  {
    g_RxVehicleSpeed = @sysvar::Disp_VehicleSpeed;
  }

  // Check for ASIL-D High-Severity Safe Stop (Chassis / Powertrain Hazard)
  if (@sysvar::Fault_ABS_WheelSpeedFL == 1 || @sysvar::Fault_Node_Cutoff_ABS == 1 || @sysvar::Fault_ECM_ThrottleSensor == 1 || @sysvar::Fault_Node_Cutoff_ECM == 1 || @sysvar::Node_Health_ABS == 2 || @sysvar::Node_Health_ECM == 2)
  {
    isAsilDSafeStop = 1;
  }

  // Cross-Dependency Check 1: ABS Wheel Speed Anomaly (C0035 propagation)
  if (g_RxSpeedFL < 5.0 && g_RxSpeedFR > 25.0)
  {
    if (g_Symptom_U0415_Active == 0)
    {
      g_Symptom_U0415_Active = 1;
      AddDTC(0xD41581, (DTC_STATUS_TEST_FAILED | DTC_STATUS_CONFIRMED_DTC)); // U0415-81
      write("[TCM] SECONDARY SYMPTOM DETECTED: U0415-81 (Invalid Data From ABS Module). Entering Degraded Shift Mode.");
    }
  }

  // Cross-Dependency Check 2: ECM Throttle Sensor Failure (P0122 propagation)
  if (g_RxThrottlePos < 1.0 && g_RxEngineRPM > 2000.0)
  {
    if (g_Symptom_U0401_Active == 0)
    {
      g_Symptom_U0401_Active = 1;
      AddDTC(0xD40186, (DTC_STATUS_TEST_FAILED | DTC_STATUS_CONFIRMED_DTC)); // U0401-86
      write("[TCM] SECONDARY SYMPTOM DETECTED: U0401-86 (Invalid Data From ECM).");
    }
  }

  // Cross-Dependency Check 3: ECM Node Loss (Timeout > 250ms)
  if ((timeNow() - g_LastECMTimestamp) > 250000 && g_LastECMTimestamp > 0)
  {
    if (g_Symptom_U0100_Active == 0)
    {
      g_Symptom_U0100_Active = 1;
      AddDTC(0xD10000, (DTC_STATUS_TEST_FAILED | DTC_STATUS_CONFIRMED_DTC)); // U0100-00
      write("[TCM] SECONDARY SYMPTOM DETECTED: U0100-00 (Lost Comm with ECM/PCM).");
    }
  }

  // Cross-Dependency Check 4: ABS Node Loss (Timeout > 250ms or Fault_Node_Cutoff_ABS == 1)
  if (@sysvar::Fault_Node_Cutoff_ABS == 1 || ((timeNow() - g_LastABSTimestamp) > 250000 && g_LastABSTimestamp > 0))
  {
    if (g_Symptom_ABS_Lost_Active == 0)
    {
      g_Symptom_ABS_Lost_Active = 1;
      AddDTC(0xD12100, (DTC_STATUS_TEST_FAILED | DTC_STATUS_CONFIRMED_DTC)); // U0121-00
      write("[TCM] SECONDARY SYMPTOM DETECTED: U0121-00 (Lost Comm with ABS Module).");
    }
  }

  // Latched Degraded Mode Evaluation
  g_DegradedMode = (g_Symptom_U0415_Active == 1 || g_Symptom_U0401_Active == 1 || g_Symptom_U0100_Active == 1 || g_Symptom_Coolant_Active == 1 || g_Symptom_Brake_Active == 1 || g_Symptom_ABS_Lost_Active == 1) ? 1 : 0;

  // Shift Logic (Dependent on Vehicle Speed & Degradation)
  if (isAsilDSafeStop == 1 || g_RxVehicleSpeed < 1.0)
  {
    g_CurrentGear = 3; // DBC enum D1
    g_TargetGear = 3;
    @sysvar::Disp_CurrentGear = 1; // Standstill 1st gear
  }
  else if (g_DegradedMode == 1)
  {
    g_CurrentGear = 5; // DBC enum D3
    g_TargetGear = 5;
    @sysvar::Disp_CurrentGear = 3; // Lock display to 3rd gear limp mode
  }
  else
  {
    // Normal Automatic Transmission Shift Schedule
    if (g_RxVehicleSpeed < 25.0)       { g_CurrentGear = 3; g_TargetGear = 3; @sysvar::Disp_CurrentGear = 1; } // 1st gear (0 - 25 km/h)
    else if (g_RxVehicleSpeed < 50.0)  { g_CurrentGear = 4; g_TargetGear = 4; @sysvar::Disp_CurrentGear = 2; } // 2nd gear (25 - 50 km/h)
    else if (g_RxVehicleSpeed < 75.0)  { g_CurrentGear = 5; g_TargetGear = 5; @sysvar::Disp_CurrentGear = 3; } // 3rd gear (50 - 75 km/h)
    else if (g_RxVehicleSpeed < 100.0) { g_CurrentGear = 6; g_TargetGear = 6; @sysvar::Disp_CurrentGear = 4; } // 4th gear (75 - 100 km/h)
    else                               { g_CurrentGear = 7; g_TargetGear = 7; @sysvar::Disp_CurrentGear = 5; } // 5th gear (> 100 km/h)
  }

  // Populate CAN Payload (0x300)
  msg_TCM.byte(0) = g_CurrentGear | (g_TargetGear << 4);
  msg_TCM.byte(1) = g_ClutchStatus;
  msg_TCM.byte(2) = (byte)(g_TransOilTemp + 40.0);
  msg_TCM.byte(3) = g_DegradedMode & 0x01;
  msg_TCM.byte(4) = (g_NumDTCs > 0) ? 0x01 : 0x00;
  msg_TCM.byte(5) = 0x00;
  msg_TCM.byte(6) = g_AliveCounter;
  msg_TCM.byte(7) = (msg_TCM.byte(0) ^ msg_TCM.byte(1) ^ msg_TCM.byte(2) ^ msg_TCM.byte(6)) & 0xFF;

  // Node Health State: LATCHED until Reset_TCM_Node()!
  if (g_Fault_Cutoff_TCM_Active == 1 || @sysvar::Fault_Node_Cutoff_TCM == 1)
  {
    @sysvar::Node_Health_TCM = 2; // Red (Root Cause Cutoff)
  }
  else if (g_DegradedMode == 1)
  {
    @sysvar::Node_Health_TCM = 1; // Yellow (Degraded / Secondary Symptom) - LATCHED until Reset!
  }
  else
  {
    @sysvar::Node_Health_TCM = 0; // Green (Healthy)
  }

  if (@sysvar::Fault_Node_Cutoff_TCM == 0 && g_Fault_Cutoff_TCM_Active == 0)
  {
    output(msg_TCM);
  }

  setTimer(t_TCM_20ms, 20);
}

// -----------------------------------------------------------------------------
// Subscriptions: ECM_Data_1 (0x100), ECM_Data_2 (0x105), ABS (0x200), BCM (0x400)
// -----------------------------------------------------------------------------
on message 0x100
{
  word rawRPM;
  rawRPM = (word)(this.byte(0) | ((word)this.byte(1) << 8));
  g_RxEngineRPM = (double)rawRPM * 0.25;
  g_RxThrottlePos = this.byte(2) * 0.5;
  g_LastECMTimestamp = timeNow();
}

on message 0x105
{
  double rxCoolantTemp;
  rxCoolantTemp = (double)this.byte(0) - 40.0;
  if (rxCoolantTemp > 125.0)
  {
    if (g_Symptom_Coolant_Active == 0)
    {
      g_Symptom_Coolant_Active = 1;
      AddDTC(0xD40182, (DTC_STATUS_TEST_FAILED | DTC_STATUS_CONFIRMED_DTC)); // U0401-82
      write("[TCM] SECONDARY SYMPTOM DETECTED: U0401-82 (Invalid Data from ECM - Engine Temp Range).");
    }
  }
  else if (rxCoolantTemp <= 110.0 && g_Symptom_Coolant_Active == 1)
  {
    g_Symptom_Coolant_Active = 0;
  }
}

on message 0x200
{
  word rawFL;
  word rawFR;
  rawFL = (word)(this.byte(0) | ((word)this.byte(1) << 8));
  rawFR = (word)(this.byte(2) | ((word)this.byte(3) << 8));
  g_RxSpeedFL = (double)rawFL * 0.01;
  g_RxSpeedFR = (double)rawFR * 0.01;
  g_RxVehicleSpeed = (g_RxSpeedFL + g_RxSpeedFR) / 2.0;
  g_LastABSTimestamp = timeNow();
}

on message 0x205
{
  word rawSpeed;
  rawSpeed = (word)(this.byte(0) | ((word)this.byte(1) << 8));
  g_RxVehicleSpeed = (double)rawSpeed * 0.01;
  g_LastABSTimestamp = timeNow();
}

on message 0x400
{
  byte brakePressed;
  brakePressed = (this.byte(0) >> 2) & 0x01;
  if (brakePressed == 1 && g_RxVehicleSpeed > 40.0)
  {
    if (g_Symptom_Brake_Active == 0)
    {
      g_Symptom_Brake_Active = 1;
      AddDTC(0xD42281, (DTC_STATUS_TEST_FAILED | DTC_STATUS_CONFIRMED_DTC)); // U0422-81
      write("[TCM] SECONDARY SYMPTOM DETECTED: U0422-81 (Invalid Data from BCM - Brake Switch Conflict).");
    }
  }
  else if (brakePressed == 0 && g_Symptom_Brake_Active == 1)
  {
    g_Symptom_Brake_Active = 0;
  }
}

// -----------------------------------------------------------------------------
// UDS Diagnostic Server (0x7E1 Physical / 0x7DF Functional)
// -----------------------------------------------------------------------------
on message 0x7E1, 0x7DF
{
  byte sid;
  byte subf;
  sid = this.byte(1);

  if (sid == UDS_SID_DIAGNOSTIC_SESSION_CONTROL)
  {
    subf = this.byte(2);
    g_DiagSession = subf;
    msg_TCM_DiagResp.byte(0) = 0x06;
    msg_TCM_DiagResp.byte(1) = 0x50;
    msg_TCM_DiagResp.byte(2) = subf;
    msg_TCM_DiagResp.byte(3) = 0x00;
    msg_TCM_DiagResp.byte(4) = 0x32;
    msg_TCM_DiagResp.byte(5) = 0x01;
    msg_TCM_DiagResp.byte(6) = 0xF4;
    msg_TCM_DiagResp.byte(7) = 0xAA;
    msg_TCM_DiagResp.dlc = 8;
    output(msg_TCM_DiagResp);
  }
  else if (sid == UDS_SID_CLEAR_DIAGNOSTIC_INFORMATION)
  {
    Reset_TCM_Node();
    msg_TCM_DiagResp.byte(0) = 0x01;
    msg_TCM_DiagResp.byte(1) = 0x54;
    msg_TCM_DiagResp.byte(2) = 0xAA;
    msg_TCM_DiagResp.dlc = 8;
    output(msg_TCM_DiagResp);
    write("[TCM-UDS] DTCs Cleared.");
  }
  else if (sid == UDS_SID_READ_DTC_INFORMATION)
  {
    subf = this.byte(2);
    if (subf == UDS_SUBF_REPORT_DTC_BY_STATUS_MASK)
    {
      if (g_NumDTCs == 0)
      {
        msg_TCM_DiagResp.byte(0) = 0x03;
        msg_TCM_DiagResp.byte(1) = 0x59;
        msg_TCM_DiagResp.byte(2) = 0x02;
        msg_TCM_DiagResp.byte(3) = 0x00;
        msg_TCM_DiagResp.dlc = 8;
        output(msg_TCM_DiagResp);
      }
      else
      {
        msg_TCM_DiagResp.byte(0) = 0x06;
        msg_TCM_DiagResp.byte(1) = 0x59;
        msg_TCM_DiagResp.byte(2) = 0x02;
        msg_TCM_DiagResp.byte(3) = (g_TCM_DTCs[0].dtcNumber >> 16) & 0xFF;
        msg_TCM_DiagResp.byte(4) = (g_TCM_DTCs[0].dtcNumber >> 8) & 0xFF;
        msg_TCM_DiagResp.byte(5) = (g_TCM_DTCs[0].dtcNumber) & 0xFF;
        msg_TCM_DiagResp.byte(6) = g_TCM_DTCs[0].statusMask;
        msg_TCM_DiagResp.byte(7) = 0xAA;
        msg_TCM_DiagResp.dlc = 8;
        output(msg_TCM_DiagResp);
        write("[TCM-UDS] ReadDTC response sent: 0x%06X (Status: 0x%02X)", g_TCM_DTCs[0].dtcNumber, g_TCM_DTCs[0].statusMask);
      }
    }
  }
  else if (sid == UDS_SID_READ_DATA_BY_IDENTIFIER)
  {
    word did;
    did = (this.byte(2) << 8) | this.byte(3);
    if (did == 0x0300) // TCM Gear State DID
    {
      msg_TCM_DiagResp.byte(0) = 0x04;
      msg_TCM_DiagResp.byte(1) = 0x62;
      msg_TCM_DiagResp.byte(2) = 0x03;
      msg_TCM_DiagResp.byte(3) = 0x00;
      msg_TCM_DiagResp.byte(4) = g_CurrentGear;
      msg_TCM_DiagResp.dlc = 8;
      output(msg_TCM_DiagResp);
    }
  }
}

void AddDTC(dword dtcCode, byte status)
{
  int i;
  for (i = 0; i < g_NumDTCs; i++)
  {
    if (g_TCM_DTCs[i].dtcNumber == dtcCode)
    {
      g_TCM_DTCs[i].statusMask = status;
      return;
    }
  }
  if (g_NumDTCs < MAX_DTCS)
  {
    g_TCM_DTCs[g_NumDTCs].dtcNumber = dtcCode;
    g_TCM_DTCs[g_NumDTCs].statusMask = status;
    g_NumDTCs++;
  }
}

void Reset_TCM_Node()
{
  g_NumDTCs = 0;
  g_Fault_Cutoff_TCM_Active = 0;
  g_Symptom_U0415_Active = 0;
  g_Symptom_U0401_Active = 0;
  g_Symptom_U0100_Active = 0;
  g_Symptom_Coolant_Active = 0;
  g_Symptom_Brake_Active = 0;
  g_Symptom_ABS_Lost_Active = 0;
  g_DegradedMode = 0;
  g_RxVehicleSpeed = 0.0;
  g_RxSpeedFL = 0.0;
  g_RxSpeedFR = 0.0;
  g_CurrentGear = 3;
  g_TargetGear = 3;
  @sysvar::Disp_CurrentGear = 1;
  @sysvar::Node_Health_TCM = 0;
  write("[TCM] Reset: All DTCs and secondary symptom flags cleared.");
}

on sysvar sysvar::Fault_Reset_All
{
  if (@sysvar::Fault_Reset_All == 1)
  {
    Reset_TCM_Node();
  }
}
