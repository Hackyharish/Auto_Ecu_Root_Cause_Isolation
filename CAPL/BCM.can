/*@!Encoding:1252*/
/* =========================================================================
   Node: BCM.can (Body Control Module)
   Project: Automated Root Cause Isolation in Multi-ECU Networks
   Description: Simulates Body Control Module (Power mode, Brake switch,
                Cluster warnings) & UDS Diagnostic Server (0x7E3 / 0x7EB).
   Author: IVN Capstone Team | Tata Technologies TechPulse
   ========================================================================= */

includes
{
  #include "Common_UDS.cin"
}

variables
{
  msTimer t_BCM_50ms;

  message 0x400 msg_BCM;
  message 0x7EB msg_BCM_DiagResp;

  byte g_IgnitionState = 2; // ON
  byte g_BrakeSwitch = 0;   // RELEASED
  byte g_DriverDoor = 0;    // CLOSED
  byte g_HazardState = 0;   // OFF
  byte g_AliveCounter = 0;

  // Diagnostic State & DTC Memory
  byte g_DiagSession = UDS_SUBF_DEFAULT_SESSION;
  struct DTCEntry g_BCM_DTCs[MAX_DTCS];
  int g_NumDTCs = 0;

  // Fault Tracking Flags
  byte g_Fault_BrakeActive = 0;
  byte g_Fault_Cutoff_BCM_Active = 0;
  byte g_Symptom_Coolant_Active = 0;
}

on start
{
  write("[BCM] Node Initialized. Starting 50ms cyclic state broadcast...");
  g_NumDTCs = 0;
  setTimer(t_BCM_50ms, 50);
}

// -----------------------------------------------------------------------------
// 50ms Cyclic Broadcast: BCM_Status (0x400)
// -----------------------------------------------------------------------------
on timer t_BCM_50ms
{
  g_AliveCounter = (g_AliveCounter + 1) & 0x0F;
  g_IgnitionState = @sysvar::Sim_IgnitionState;

  // Latch incoming fault trigger pulses ONLY when pre-conditions met
  if (@sysvar::Sim_IgnitionState >= 2 && @sysvar::Sim_BatteryVoltage >= 9.5 && @sysvar::Sim_BatteryVoltage <= 16.0)
  {
    if (@sysvar::Fault_BCM_BrakeSwitch == 1)
    {
      g_Fault_BrakeActive = 1;
    }
    if (@sysvar::Fault_Node_Cutoff_BCM == 1)
    {
      g_Fault_Cutoff_BCM_Active = 1;
    }
  }

  // Handle Latched Fault Injection: Brake Switch Stuck High (Scenario 5) or Normal Brake Pedal
  if (g_Fault_BrakeActive == 1 || @sysvar::Sim_BrakePedal == 1)
  {
    g_BrakeSwitch = 1;
    if (g_Fault_BrakeActive == 1 && g_NumDTCs == 0)
    {
      AddDTC(0x931811, (DTC_STATUS_TEST_FAILED | DTC_STATUS_CONFIRMED_DTC)); // B1318-11
      write("[BCM] PRIMARY ROOT FAULT QUALIFIED: B1318-11 (Brake Switch Circuit Short/Stuck High).");
    }
  }
  else
  {
    g_BrakeSwitch = 0;
  }

  msg_BCM.byte(0) = (g_IgnitionState & 0x03) | ((g_BrakeSwitch & 0x01) << 2) | ((g_DriverDoor & 0x01) << 3) | ((g_HazardState & 0x01) << 4);
  msg_BCM.byte(1) = 0x00;
  msg_BCM.byte(2) = 0x00;
  msg_BCM.byte(3) = 0x00;
  msg_BCM.byte(4) = 0x00;
  msg_BCM.byte(5) = 0x00;
  msg_BCM.byte(6) = g_AliveCounter;
  msg_BCM.byte(7) = (msg_BCM.byte(0) ^ msg_BCM.byte(6)) & 0xFF;
  msg_BCM.dlc = 8;

  // Update Panel Node Health: LATCHED until Reset_BCM_Node()!
  if (g_Fault_BrakeActive == 1 || g_Fault_Cutoff_BCM_Active == 1 || @sysvar::Fault_Node_Cutoff_BCM == 1)
  {
    @sysvar::Node_Health_BCM = 2; // Red (Root Cause)
  }
  else if (g_Symptom_Coolant_Active == 1)
  {
    @sysvar::Node_Health_BCM = 1; // Yellow (Secondary Cascade)
  }
  else
  {
    @sysvar::Node_Health_BCM = 0; // Green (Healthy)
  }

  if (@sysvar::Fault_Node_Cutoff_BCM == 0 && g_Fault_Cutoff_BCM_Active == 0)
  {
    output(msg_BCM);
  }

  setTimer(t_BCM_50ms, 50);
}

// -----------------------------------------------------------------------------
// Subscribed Message: ECM_Data_2 (0x105) -> Track Engine Overheat Cascade
// -----------------------------------------------------------------------------
on message 0x105
{
  double rxCoolantTemp;
  rxCoolantTemp = (double)this.byte(0) - 40.0;

  if (rxCoolantTemp > 125.0)
  {
    if (g_Symptom_Coolant_Active == 0)
    {
      g_Symptom_Coolant_Active = 1;
      AddDTC(0x90A200, (DTC_STATUS_TEST_FAILED | DTC_STATUS_CONFIRMED_DTC)); // B10A2-00
      write("[BCM] SECONDARY SYMPTOM DETECTED: B10A2-00 (Cluster High Coolant Temperature Warning).");
    }
  }
  else if (rxCoolantTemp <= 110.0 && g_Symptom_Coolant_Active == 1)
  {
    g_Symptom_Coolant_Active = 0;
  }
}

// -----------------------------------------------------------------------------
// UDS Diagnostic Server (0x7E3 Physical / 0x7DF Functional)
// -----------------------------------------------------------------------------
on message 0x7E3, 0x7DF
{
  byte sid;
  byte subf;
  byte reqMask;
  int j;

  if (@sysvar::Fault_Node_Cutoff_BCM == 1 || g_Fault_Cutoff_BCM_Active == 1)
  {
    return; // Node is cut off / bus-off; cannot transmit diagnostic response
  }
  sid = this.byte(1);
  for (j = 0; j < 8; j++) msg_BCM_DiagResp.byte(j) = 0xAA;
  msg_BCM_DiagResp.dlc = 8;

  if (sid == UDS_SID_DIAGNOSTIC_SESSION_CONTROL)
  {
    subf = this.byte(2);
    g_DiagSession = subf & 0x7F;
    if ((subf & 0x80) != 0) return;
    msg_BCM_DiagResp.byte(0) = 0x06;
    msg_BCM_DiagResp.byte(1) = 0x50;
    msg_BCM_DiagResp.byte(2) = g_DiagSession;
    msg_BCM_DiagResp.byte(3) = 0x00;
    msg_BCM_DiagResp.byte(4) = 0x32;
    msg_BCM_DiagResp.byte(5) = 0x01;
    msg_BCM_DiagResp.byte(6) = 0xF4;
    output(msg_BCM_DiagResp);
  }
  else if (sid == UDS_SID_ECU_RESET)
  {
    subf = this.byte(2);
    Reset_BCM_Node();
    if ((subf & 0x80) != 0) return;
    msg_BCM_DiagResp.byte(0) = 0x02;
    msg_BCM_DiagResp.byte(1) = 0x51;
    msg_BCM_DiagResp.byte(2) = subf & 0x7F;
    output(msg_BCM_DiagResp);
    write("[BCM-UDS] ECUReset (0x%02X) executed.", subf & 0x7F);
  }
  else if (sid == UDS_SID_CLEAR_DIAGNOSTIC_INFORMATION)
  {
    Reset_BCM_Node();
    msg_BCM_DiagResp.byte(0) = 0x01;
    msg_BCM_DiagResp.byte(1) = 0x54;
    output(msg_BCM_DiagResp);
    write("[BCM-UDS] DTCs Cleared.");
  }
  else if (sid == UDS_SID_READ_DTC_INFORMATION)
  {
    subf = this.byte(2);
    if (subf == UDS_SUBF_REPORT_NUMBER_OF_DTC_BY_MASK)
    {
      msg_BCM_DiagResp.byte(0) = 0x06;
      msg_BCM_DiagResp.byte(1) = 0x59;
      msg_BCM_DiagResp.byte(2) = 0x01;
      msg_BCM_DiagResp.byte(3) = 0x09;
      msg_BCM_DiagResp.byte(4) = 0x01;
      msg_BCM_DiagResp.byte(5) = 0x00;
      msg_BCM_DiagResp.byte(6) = (g_NumDTCs > 0) ? 1 : 0;
      output(msg_BCM_DiagResp);
    }
    else if (subf == UDS_SUBF_REPORT_DTC_BY_STATUS_MASK)
    {
      reqMask = (this.byte(0) >= 3) ? this.byte(3) : 0xFF;
      if (g_NumDTCs == 0 || reqMask == 0x00 || ((g_BCM_DTCs[0].statusMask & reqMask) == 0 && reqMask != 0xFF))
      {
        msg_BCM_DiagResp.byte(0) = 0x03;
        msg_BCM_DiagResp.byte(1) = 0x59;
        msg_BCM_DiagResp.byte(2) = 0x02;
        msg_BCM_DiagResp.byte(3) = 0x09;
        output(msg_BCM_DiagResp);
      }
      else
      {
        msg_BCM_DiagResp.byte(0) = 0x07;
        msg_BCM_DiagResp.byte(1) = 0x59;
        msg_BCM_DiagResp.byte(2) = 0x02;
        msg_BCM_DiagResp.byte(3) = 0x09;
        msg_BCM_DiagResp.byte(4) = (g_BCM_DTCs[0].dtcNumber >> 16) & 0xFF;
        msg_BCM_DiagResp.byte(5) = (g_BCM_DTCs[0].dtcNumber >> 8) & 0xFF;
        msg_BCM_DiagResp.byte(6) = (g_BCM_DTCs[0].dtcNumber) & 0xFF;
        msg_BCM_DiagResp.byte(7) = g_BCM_DTCs[0].statusMask;
        output(msg_BCM_DiagResp);
      }
    }
    else if (this.id != CAN_ID_DIAG_FUNCTIONAL_REQ)
    {
      msg_BCM_DiagResp.byte(0) = 0x03;
      msg_BCM_DiagResp.byte(1) = UDS_SID_NEGATIVE_RESPONSE;
      msg_BCM_DiagResp.byte(2) = sid;
      msg_BCM_DiagResp.byte(3) = UDS_NRC_SUBFUNCTION_NOT_SUPPORTED;
      output(msg_BCM_DiagResp);
    }
  }
  else if (sid == UDS_SID_READ_DATA_BY_IDENTIFIER)
  {
    word did;
    did = (this.byte(2) << 8) | this.byte(3);
    if (did == 0x0400) // Chassis Switch State DID
    {
      msg_BCM_DiagResp.byte(0) = 0x04;
      msg_BCM_DiagResp.byte(1) = 0x62;
      msg_BCM_DiagResp.byte(2) = 0x04;
      msg_BCM_DiagResp.byte(3) = 0x00;
      msg_BCM_DiagResp.byte(4) = ((g_IgnitionState & 0x0F) << 4) | (g_BrakeSwitch & 0x01);
      output(msg_BCM_DiagResp);
    }
    else if (this.id != CAN_ID_DIAG_FUNCTIONAL_REQ)
    {
      msg_BCM_DiagResp.byte(0) = 0x03;
      msg_BCM_DiagResp.byte(1) = UDS_SID_NEGATIVE_RESPONSE;
      msg_BCM_DiagResp.byte(2) = sid;
      msg_BCM_DiagResp.byte(3) = UDS_NRC_REQUEST_OUT_OF_RANGE;
      output(msg_BCM_DiagResp);
    }
  }
  else if (sid == UDS_SID_TESTER_PRESENT)
  {
    subf = this.byte(2);
    if ((subf & 0x80) != 0) return;
    msg_BCM_DiagResp.byte(0) = 0x02;
    msg_BCM_DiagResp.byte(1) = 0x7E;
    msg_BCM_DiagResp.byte(2) = subf & 0x7F;
    output(msg_BCM_DiagResp);
  }
  else if (this.id != CAN_ID_DIAG_FUNCTIONAL_REQ)
  {
    msg_BCM_DiagResp.byte(0) = 0x03;
    msg_BCM_DiagResp.byte(1) = UDS_SID_NEGATIVE_RESPONSE;
    msg_BCM_DiagResp.byte(2) = sid;
    msg_BCM_DiagResp.byte(3) = UDS_NRC_SERVICE_NOT_SUPPORTED;
    output(msg_BCM_DiagResp);
  }
}

void AddDTC(dword dtcCode, byte status)
{
  int i;
  for (i = 0; i < g_NumDTCs; i++)
  {
    if (g_BCM_DTCs[i].dtcNumber == dtcCode)
    {
      g_BCM_DTCs[i].statusMask = status;
      return;
    }
  }
  if (g_NumDTCs < MAX_DTCS)
  {
    g_BCM_DTCs[g_NumDTCs].dtcNumber = dtcCode;
    g_BCM_DTCs[g_NumDTCs].statusMask = status;
    g_NumDTCs++;
  }
}

void Reset_BCM_Node()
{
  g_NumDTCs = 0;
  g_BrakeSwitch = 0;
  g_Fault_BrakeActive = 0;
  g_Fault_Cutoff_BCM_Active = 0;
  g_Symptom_Coolant_Active = 0;
  @sysvar::Node_Health_BCM = 0;
  write("[BCM] Reset: All DTCs and fault flags cleared.");
}

on sysvar sysvar::Fault_Reset_All
{
  if (@sysvar::Fault_Reset_All == 1)
  {
    Reset_BCM_Node();
  }
}

on sysvar sysvar::Fault_BCM_BrakeSwitch
{
  if (@this == 1 && @sysvar::Sim_IgnitionState >= 2 && @sysvar::Sim_BatteryVoltage >= 9.5 && @sysvar::Sim_BatteryVoltage <= 16.0)
  {
    g_Fault_BrakeActive = 1;
  }
}
