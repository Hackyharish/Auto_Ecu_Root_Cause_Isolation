/*@!Encoding:1252*/
/* =========================================================================
   Node: ABS_ESP.can (Anti-Lock Braking & Stability Program)
   Project: Automated Root Cause Isolation in Multi-ECU Networks
   Description: Simulates ABS/ESP ECU with wheel speed computation,
                Wheel Speed Sensor (WSS) fault injection, DTC qualification,
                and UDS Diagnostic Server (ISO 14229 / ISO 15765-2).
   Author: IVN Capstone Team | Tata Technologies TechPulse
   ========================================================================= */

includes
{
  #include "Common_UDS.cin"
}

variables
{
  // Timers
  msTimer t_ABS_10ms;
  msTimer t_ABS_20ms;

  // CAN Messages
  message 0x200 msg_ABS_Speeds;
  message 0x205 msg_ABS_Dyn;
  message 0x7EA msg_ABS_DiagResp;

  // Physical State Variables
  double g_SpeedFL = 0.0;
  double g_SpeedFR = 0.0;
  double g_SpeedRL = 0.0;
  double g_SpeedRR = 0.0;
  double g_VehicleSpeed = 0.0;
  double g_YawRate = 0.0;
  double g_BrakePressure = 0.0;
  byte   g_ABS_Active = 0;
  byte   g_ESP_Fault = 0;
  byte   g_AliveCounter = 0;

  // Diagnostic State & DTC Memory
  byte g_DiagSession = UDS_SUBF_DEFAULT_SESSION;
  struct DTCEntry g_ABS_DTCs[MAX_DTCS];
  int g_NumDTCs = 0;

  // Fault State Tracker
  byte g_Fault_WSS_FL_Active = 0;
  byte g_Fault_WSS_DTCAdded = 0;
  byte g_Fault_Cutoff_ABS_Active = 0;
  byte g_Fault_ECM_Throttle_Active = 0;
  byte g_Fault_ECM_Cutoff_Active = 0;
}

on start
{
  write("[ABS_ESP] Node Initialized. Starting 10ms wheel speed cyclic broadcast...");
  g_NumDTCs = 0;
  setTimer(t_ABS_10ms, 10);
  setTimer(t_ABS_20ms, 20);
}

// -----------------------------------------------------------------------------
// 10ms Cyclic Broadcast: ABS_WheelSpeeds (0x200)
// -----------------------------------------------------------------------------
on timer t_ABS_10ms
{
  byte isAsilDSafeStop;
  isAsilDSafeStop = 0;

  // Diagnostic Enable Criteria & Vehicle Operational State Check
  if (@sysvar::Sim_IgnitionState < 2)
  {
    g_VehicleSpeed = 0.0;
    g_SpeedFL = 0.0;
    g_SpeedFR = 0.0;
    g_SpeedRL = 0.0;
    g_SpeedRR = 0.0;
    g_BrakePressure = 0.0;
  }
  else
  {
    // Latch incoming fault trigger pulses ONLY when pre-conditions met
    if (@sysvar::Sim_BatteryVoltage >= 9.5 && @sysvar::Sim_BatteryVoltage <= 16.0)
    {
      if (@sysvar::Fault_ABS_WheelSpeedFL == 1)
      {
        g_Fault_WSS_FL_Active = 1;
      }
      if (@sysvar::Fault_Node_Cutoff_ABS == 1)
      {
        g_Fault_Cutoff_ABS_Active = 1;
      }
      if (@sysvar::Fault_ECM_ThrottleSensor == 1)
      {
        g_Fault_ECM_Throttle_Active = 1;
      }
      if (@sysvar::Fault_Node_Cutoff_ECM == 1)
      {
        g_Fault_ECM_Cutoff_Active = 1;
      }
    }
  }

  // Check for ASIL-D High Severity Hazards (ABS WSS, ABS Node Cutoff, ECM Throttle, ECM Node Cutoff)
  if (@sysvar::Sim_IgnitionState >= 2 && (g_Fault_WSS_FL_Active == 1 || g_Fault_Cutoff_ABS_Active == 1 || g_Fault_ECM_Throttle_Active == 1 || g_Fault_ECM_Cutoff_Active == 1))
  {
    isAsilDSafeStop = 1;
  }

  // Calculate Target Speed and Brake Dynamics: Safe stop/Brake brings target to 0, pedal demands 0..160 km/h
  {
    double targetSpeed;
    targetSpeed = 0.0;

    if (isAsilDSafeStop == 1)
    {
      targetSpeed = 0.0; // Emergency Safe Stop target
      if (g_VehicleSpeed > 0.5)
      {
        g_BrakePressure = 65.0; // Active emergency hydraulic braking (bar)
      }
      else
      {
        g_BrakePressure = 20.0; // Standstill hill-hold pressure (bar)
      }
    }
    else if (@sysvar::Sim_BrakePedal == 1)
    {
      targetSpeed = 0.0; // Service brake pedal overrides accelerator demand
      if (g_VehicleSpeed > 0.5)
      {
        g_BrakePressure = 50.0; // Service brake hydraulic pressure (bar)
      }
      else
      {
        g_BrakePressure = 15.0; // Standstill brake hold (bar)
      }
    }
    else if (@sysvar::Sim_AcceleratorPedal > 0.0)
    {
      targetSpeed = @sysvar::Sim_AcceleratorPedal * 1.6; // Demand target speed
      g_BrakePressure = 0.0; // Brakes released under throttle
    }
    else
    {
      targetSpeed = 0.0; // Idle coasting
      g_BrakePressure = 0.0;
    }

    // Dynamic Speed Ramp (10ms cycle)
    if (g_VehicleSpeed < targetSpeed)
    {
      // Gradual acceleration ramp (+0.8 km/h per 10ms = 80 km/h/s)
      g_VehicleSpeed = g_VehicleSpeed + 0.8;
      if (g_VehicleSpeed > targetSpeed)
      {
        g_VehicleSpeed = targetSpeed;
      }
    }
    else if (g_VehicleSpeed > targetSpeed)
    {
      if (@sysvar::Sim_BrakePedal == 1 || isAsilDSafeStop == 1)
      {
        // Active hydraulic braking deceleration (-1.0 km/h per 10ms = 100 km/h/s)
        g_VehicleSpeed = g_VehicleSpeed - 1.0;
      }
      else
      {
        // Gentle engine overrun coasting (-0.4 km/h per 10ms = 40 km/h/s)
        g_VehicleSpeed = g_VehicleSpeed - 0.4;
      }

      if (g_VehicleSpeed < targetSpeed)
      {
        g_VehicleSpeed = targetSpeed;
      }
    }
  }

  g_SpeedFR = g_VehicleSpeed;
  g_SpeedRL = g_VehicleSpeed;
  g_SpeedRR = g_VehicleSpeed;

  // Handle Latched Primary Fault Injection: Front-Left Wheel Speed Sensor Failure
  if (g_Fault_WSS_FL_Active == 1)
  {
    g_SpeedFL = 0.0; // Sensor signal dropped to 0 km/h
    g_ESP_Fault = 1;
    if (g_Fault_WSS_DTCAdded == 0)
    {
      g_Fault_WSS_DTCAdded = 1;
      AddDTC(0xC00351, (DTC_STATUS_TEST_FAILED | DTC_STATUS_CONFIRMED_DTC)); // C0035-13
      write("[ABS_ESP] PRIMARY ROOT FAULT QUALIFIED: C0035-13 (Left Front Wheel Speed Sensor Circuit Open - ASIL D). Executing Safe Stop.");
    }
  }
  else
  {
    g_SpeedFL = g_VehicleSpeed;
    g_ESP_Fault = 0;
  }

  // Populate CAN Payload (0x200)
  msg_ABS_Speeds.byte(0) = (word)(g_SpeedFL / 0.01) & 0xFF;
  msg_ABS_Speeds.byte(1) = ((word)(g_SpeedFL / 0.01) >> 8) & 0xFF;
  msg_ABS_Speeds.byte(2) = (word)(g_SpeedFR / 0.01) & 0xFF;
  msg_ABS_Speeds.byte(3) = ((word)(g_SpeedFR / 0.01) >> 8) & 0xFF;
  msg_ABS_Speeds.byte(4) = (word)(g_SpeedRL / 0.01) & 0xFF;
  msg_ABS_Speeds.byte(5) = ((word)(g_SpeedRL / 0.01) >> 8) & 0xFF;
  msg_ABS_Speeds.byte(6) = (word)(g_SpeedRR / 0.01) & 0xFF;
  msg_ABS_Speeds.byte(7) = ((word)(g_SpeedRR / 0.01) >> 8) & 0xFF;
  msg_ABS_Speeds.dlc = 8;

  if (@sysvar::Fault_Node_Cutoff_ABS == 0)
  {
    output(msg_ABS_Speeds);
  }

  setTimer(t_ABS_10ms, 10);
}

// -----------------------------------------------------------------------------
// 20ms Cyclic Broadcast: ABS_Dynamics (0x205)
// -----------------------------------------------------------------------------
on timer t_ABS_20ms
{
  g_AliveCounter = (g_AliveCounter + 1) & 0x0F;

  // If WSS FL is failed, calculated reference vehicle speed becomes degraded
  if (g_Fault_WSS_FL_Active == 1)
  {
    g_VehicleSpeed = (g_SpeedFR + g_SpeedRL + g_SpeedRR) / 3.0;
  }

  msg_ABS_Dyn.byte(0) = (word)(g_VehicleSpeed / 0.01) & 0xFF;
  msg_ABS_Dyn.byte(1) = ((word)(g_VehicleSpeed / 0.01) >> 8) & 0xFF;
  msg_ABS_Dyn.byte(2) = (word)((g_YawRate + 100.0) / 0.05) & 0xFF;
  msg_ABS_Dyn.byte(3) = ((word)((g_YawRate + 100.0) / 0.05) >> 8) & 0xFF;
  msg_ABS_Dyn.byte(4) = (byte)g_BrakePressure;
  msg_ABS_Dyn.byte(5) = (g_ABS_Active & 0x01) | ((g_ESP_Fault & 0x01) << 1) | (g_AliveCounter << 4);
  msg_ABS_Dyn.byte(6) = (msg_ABS_Dyn.byte(0) ^ msg_ABS_Dyn.byte(1) ^ msg_ABS_Dyn.byte(5)) & 0xFF;
  msg_ABS_Dyn.byte(7) = 0x00;
  msg_ABS_Dyn.dlc = 8;

  // Update Panel Telemetry & Node Health
  @sysvar::Disp_VehicleSpeed = g_VehicleSpeed;
  @sysvar::Disp_ESP_Fault = g_ESP_Fault;
  @sysvar::Disp_BrakePressure = g_BrakePressure;

  if (g_Fault_WSS_FL_Active == 1 || g_Fault_Cutoff_ABS_Active == 1)
  {
    @sysvar::Node_Health_ABS = 2; // Red (Root Cause) - LATCHED until Reset!
  }
  else
  {
    @sysvar::Node_Health_ABS = 0; // Green (Healthy)
  }

  if (@sysvar::Fault_Node_Cutoff_ABS == 0)
  {
    output(msg_ABS_Dyn);
  }

  setTimer(t_ABS_20ms, 20);
}

// -----------------------------------------------------------------------------
// UDS Diagnostic Server (0x7E2 Physical / 0x7DF Functional)
// -----------------------------------------------------------------------------
on message 0x7E2, 0x7DF
{
  byte sid;
  byte subf;

  if (@sysvar::Fault_Node_Cutoff_ABS == 1 || g_Fault_Cutoff_ABS_Active == 1)
  {
    return; // Node is cut off / bus-off; cannot transmit diagnostic response
  }
  sid = this.byte(1);

  if (sid == UDS_SID_DIAGNOSTIC_SESSION_CONTROL)
  {
    subf = this.byte(2);
    g_DiagSession = subf;
    msg_ABS_DiagResp.byte(0) = 0x06;
    msg_ABS_DiagResp.byte(1) = 0x50;
    msg_ABS_DiagResp.byte(2) = subf;
    msg_ABS_DiagResp.byte(3) = 0x00;
    msg_ABS_DiagResp.byte(4) = 0x32;
    msg_ABS_DiagResp.byte(5) = 0x01;
    msg_ABS_DiagResp.byte(6) = 0xF4;
    msg_ABS_DiagResp.byte(7) = 0xAA;
    msg_ABS_DiagResp.dlc = 8;
    output(msg_ABS_DiagResp);
  }
  else if (sid == UDS_SID_CLEAR_DIAGNOSTIC_INFORMATION)
  {
    Reset_ABS_Node();
    msg_ABS_DiagResp.byte(0) = 0x01;
    msg_ABS_DiagResp.byte(1) = 0x54;
    msg_ABS_DiagResp.byte(2) = 0xAA;
    msg_ABS_DiagResp.dlc = 8;
    output(msg_ABS_DiagResp);
    write("[ABS_ESP-UDS] DTCs Cleared.");
  }
  else if (sid == UDS_SID_READ_DTC_INFORMATION)
  {
    subf = this.byte(2);
    if (subf == UDS_SUBF_REPORT_DTC_BY_STATUS_MASK)
    {
      if (g_NumDTCs == 0)
      {
        msg_ABS_DiagResp.byte(0) = 0x03;
        msg_ABS_DiagResp.byte(1) = 0x59;
        msg_ABS_DiagResp.byte(2) = 0x02;
        msg_ABS_DiagResp.byte(3) = 0x00;
        msg_ABS_DiagResp.dlc = 8;
        output(msg_ABS_DiagResp);
      }
      else
      {
        msg_ABS_DiagResp.byte(0) = 0x06;
        msg_ABS_DiagResp.byte(1) = 0x59;
        msg_ABS_DiagResp.byte(2) = 0x02;
        msg_ABS_DiagResp.byte(3) = (g_ABS_DTCs[0].dtcNumber >> 16) & 0xFF;
        msg_ABS_DiagResp.byte(4) = (g_ABS_DTCs[0].dtcNumber >> 8) & 0xFF;
        msg_ABS_DiagResp.byte(5) = (g_ABS_DTCs[0].dtcNumber) & 0xFF;
        msg_ABS_DiagResp.byte(6) = g_ABS_DTCs[0].statusMask;
        msg_ABS_DiagResp.byte(7) = 0xAA;
        msg_ABS_DiagResp.dlc = 8;
        output(msg_ABS_DiagResp);
        write("[ABS_ESP-UDS] ReadDTC response sent: 0x%06X (Status: 0x%02X)", g_ABS_DTCs[0].dtcNumber, g_ABS_DTCs[0].statusMask);
      }
    }
  }
  else if (sid == UDS_SID_READ_DATA_BY_IDENTIFIER)
  {
    word did;
    did = (this.byte(2) << 8) | this.byte(3);
    if (did == 0x0200) // Wheel Speeds Snapshot DID
    {
      msg_ABS_DiagResp.byte(0) = 0x06;
      msg_ABS_DiagResp.byte(1) = 0x62;
      msg_ABS_DiagResp.byte(2) = 0x02;
      msg_ABS_DiagResp.byte(3) = 0x00;
      msg_ABS_DiagResp.byte(4) = (byte)g_SpeedFL;
      msg_ABS_DiagResp.byte(5) = (byte)g_SpeedFR;
      msg_ABS_DiagResp.byte(6) = (byte)g_SpeedRL;
      msg_ABS_DiagResp.byte(7) = (byte)g_SpeedRR;
      msg_ABS_DiagResp.dlc = 8;
      output(msg_ABS_DiagResp);
    }
  }
}

void AddDTC(dword dtcCode, byte status)
{
  int i;
  for (i = 0; i < g_NumDTCs; i++)
  {
    if (g_ABS_DTCs[i].dtcNumber == dtcCode)
    {
      g_ABS_DTCs[i].statusMask = status;
      return;
    }
  }
  if (g_NumDTCs < MAX_DTCS)
  {
    g_ABS_DTCs[g_NumDTCs].dtcNumber = dtcCode;
    g_ABS_DTCs[g_NumDTCs].statusMask = status;
    g_NumDTCs++;
  }
}

void Reset_ABS_Node()
{
  g_NumDTCs = 0;
  g_Fault_WSS_FL_Active = 0;
  g_Fault_WSS_DTCAdded = 0;
  g_Fault_Cutoff_ABS_Active = 0;
  g_Fault_ECM_Throttle_Active = 0;
  g_Fault_ECM_Cutoff_Active = 0;
  g_ESP_Fault = 0;
  g_ABS_Active = 0;
  g_VehicleSpeed = @sysvar::Sim_AcceleratorPedal * 1.6;
  g_SpeedFL = g_VehicleSpeed;
  g_SpeedFR = g_VehicleSpeed;
  g_SpeedRL = g_VehicleSpeed;
  g_SpeedRR = g_VehicleSpeed;
  g_YawRate = 0.0;
  g_BrakePressure = 0.0;
  @sysvar::Disp_BrakePressure = 0.0;
  @sysvar::Node_Health_ABS = 0;
  write("[ABS_ESP] Reset: All faults cleared, nominal telemetry restored.");
}

on sysvar sysvar::Fault_Reset_All
{
  if (@sysvar::Fault_Reset_All == 1)
  {
    Reset_ABS_Node();
  }
}
